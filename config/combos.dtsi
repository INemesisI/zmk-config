/*                KEY POSITIONS
36 keys:
  ╭────────────────────╮ ╭────────────────────╮
  │  0   1   2   3   4 │ │  5   6   7   8   9 │
  │ 10  11  12  13  14 │ │ 15  16  17  18  19 │
  │ 20  21  22  23  24 │ │ 25  26  27  28  29 │
  ╰───────╮ 30  31  32 │ │ 33  34  35 ╭───────╯
          ╰────────────╯ ╰────────────╯      */

#define FAST 40
#define SLOW 60
#define IDLE_TIME 50

#define COMBO(NAME, BINDINGS, KEYPOS, TERM, ...) \
    combo_##NAME { \
        timeout-ms = <TERM>; \
        bindings = <BINDINGS>; \
        key-positions = <KEYPOS>; \
        layers = <CMK SYM NAV>; \
        require-prior-idle-ms = <IDLE_TIME>; \
		__VA_ARGS__ \
    };

/ {
    combos {
        compatible = "zmk,combos";
        // // UpperRow Left: &:#^
        // COMBO(amps,   &kp AMPS,      0  1, FAST)
        // COMBO(colon,  &kp COLON,     1  2, FAST)
        // COMBO(hash,   &kp HASH,      2  3, FAST)
        // COMBO(percnt, &kp CARET,     3  4, FAST)
        // // % squeezes between upper left and right
        // COMBO(caret,  &kp PRCNT,     4  5, SLOW)
        // // UpperRow Right: $";*
        // COMBO(dollar, &kp DLLR,      5  6, FAST)
        // COMBO(dqt,    &kp DQT,       6  7, FAST)
        // COMBO(semi,   &kp SEMI,      7  8, FAST)
        // COMBO(astrk,  &kp ASTRK,     8  9, FAST)
        // // HomeRow Left: [({<
        // COMBO(lbkt,   &kp LBKT,     10 11, FAST)
        // COMBO(lpar,   &kp LPAR,     11 12, FAST)
        // COMBO(lbrc,   &kp LBRC,     12 13, FAST)
        // COMBO(lt,     &kp LT,       13 14, FAST)
        // // ! squeezes between upper left and right
        // COMBO(excl,   &kp EXCL,     14 15, SLOW)
        // // HomeRow Right: >})]
        // COMBO(gt,     &kp GT,       15 16, FAST)
        // COMBO(rbrc,   &kp RBRC,     16 17, FAST)
        // COMBO(rpar,   &kp RPAR,     17 18, FAST)
        // COMBO(rbkt,   &kp RBKT,     18 19, FAST)
        // // BottomRow Left: ~-_`
        // COMBO(tilde,  &kp TILDE,    20 21, FAST)
        // COMBO(under,  &kp UNDER,    21 22, FAST)
        // COMBO(minus,  &kp MINUS,    22 23, FAST)
        // COMBO(grave,  &kp GRAVE,    23 24, FAST)
        // // ? squeezes between upper left and right
        // COMBO(at,  &kp AT,          24 25, SLOW)
        // // BottomRow Right: |+=\
        // COMBO(pipe,   &kp PIPE,     25 26, FAST)
        // COMBO(plus,   &kp PLUS,     26 27, FAST)
        // COMBO(equal,  &kp EQUAL,    27 28, FAST)
        // COMBO(bslh,   &kp BSLH,     28 29, FAST)
        
        // alt-tab support
        // COMBO(tab,    &kp TAB,      11 13, FAST)
        
        // COMBO(capswd, &caps_word,   13 16, SLOW)
    };
};
