## config/boards/arm/swippy/Kconfig.board
```kconfig
# swippy board configuration

# Copyright (c) 2020 Pete Johanson
# SPDX-License-Identifier: MIT

config BOARD_SWIPPY
    bool "swippy"
    depends on SOC_NRF52840_QIAA
```

## config/boards/shields/swifty/Kconfig.shield
```kconfig
# Copyright (c) 2022 The ZMK Contributors
# SPDX-License-Identifier: MIT

config SHIELD_SWIFTY_LEFT
    def_bool $(shields_list_contains,swifty_left)

config SHIELD_SWIFTY_RIGHT
    def_bool $(shields_list_contains,swifty_right)

config SHIELD_SWIFTY_DONGLE
    def_bool $(shields_list_contains,swifty_dongle)
```

## config/boards/shields/swweeep/Kconfig.defconfig
```kconfig
# Copyright (c) 2022 The ZMK Contributors
# SPDX-License-Identifier: MIT

if SHIELD_SWWEEEP_LEFT

config ZMK_KEYBOARD_NAME
	default "Benes Keyboard"

config ZMK_SPLIT_ROLE_CENTRAL
	default y

config ZMK_USB
	default y

config ZMK_STUDIO
	default y

endif

if SHIELD_SWWEEEP_LEFT || SHIELD_SWWEEEP_RIGHT || SHIELD_SWWEEEP_DONGLE

config ZMK_SPLIT
	default y

config ZMK_BLE
	default y

endif
```
